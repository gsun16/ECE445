## pcb_programming/sdkconfig.defaults
```kconfig
CONFIG_BT_ENABLED=y
CONFIG_BT_CLASSIC_ENABLED=y
CONFIG_BT_A2DP_SINK_ENABLED=y
CONFIG_BT_A2DP_SOURCE_ENABLED=y
CONFIG_BT_AVRC_CONTROLLER_ENABLED=y
CONFIG_BT_AVRC_TG_ENABLED=y
```
